## crypto/ocf/sectest/Kconfig
```kconfig
#
# SEC driver testing configuration
#

menu "SEC Test Options"
#	depends on MPC836x_MDS
	depends on OCF_TALITOS
config SEC_TEST
	tristate "SEC1.x and SEC2.x testing support"
#	depends on 83xx
	depends on OCF_TALITOS
	default M
endmenu
```

## crypto/ocf/talitos/Kconfig
```kconfig
menu "Talitos Driver"

config OCF_TALITOS
	tristate "talitos (HW crypto engine)"
	depends on OCF_OCF
	help
	  OCF driver for Freescale's security engine (SEC/talitos).

config OCF_TALITOS_GTIMER
	tristate "global timer used with talitos"
	depends on OCF_TALITOS
	help
	  Global timer driver.

config OCF_TALITOS_KTIMER
	tristate "kernel timer used with talitos"
	depends on OCF_TALITOS
	help
	  Global timer driver.
endmenu
```

## drivers/net/can/Kconfig
```kconfig
menu "CAN Device Drivers"
	depends on CAN

config CAN_VCAN
	tristate "Virtual Local CAN Interface (vcan)"
	depends on CAN
	default N
	---help---
	  Similar to the network loopback devices, vcan offers a
	  virtual local CAN interface.

	  This driver can also be built as a module.  If so, the module
	  will be called vcan.

config CAN_FLEXCAN
	tristate "Support for Freescale FLEXCAN based chips"
	depends on CAN && (PPC || M68K || M68KNOMMU)
	---help---
	  Say Y here if you want to support for Freescale FlexCAN.

config CAN_MCF547X_8X
	tristate "Freescale MCF547X/MCF548X onboard CAN controller"
	depends on CAN_FLEXCAN && (M547X || M548X)
	---help---
	  Say Y here if you want to support for Freescale MCF547x/MCF548x
	  onboard dualCAN controller.

config CAN_DEBUG_DEVICES
	bool "CAN devices debugging messages"
	depends on CAN
	default N
	---help---
	  Say Y here if you want the CAN device drivers to produce a bunch of
	  debug messages to the system log.  Select this if you are having
	  a problem with CAN support and want to see more of what is going
	  on.

endmenu
```

## drivers/net/fec/Kconfig
```kconfig
config FEC_548x
	tristate "MCF547x/MCF548x Fast Ethernet Controller support"
	depends on M547X_8X
 	help
	  The MCF547x and MCF548x have a built-in Fast Ethernet Controller.
	  Saying Y here will include support for this device in the kernel.

	  To compile this driver as a module, choose M here: the module
	  will be called fecm.

config FEC_548x_AUTO_NEGOTIATION
	bool "Enable Auto-Negotiation"
	depends on FEC_548x
	help
	  This option enables the FEC to automatically detect the 
	  half/full duplex mode and the network speed at initialization
	  If you want this, say Y.

config FEC_548x_ENABLE_FEC2
	bool "Enable the second FEC"
	depends on FEC_548x
	help
	  This enables the second FEC on the 547x/548x. If you want to use
	  it, say Y.
```
